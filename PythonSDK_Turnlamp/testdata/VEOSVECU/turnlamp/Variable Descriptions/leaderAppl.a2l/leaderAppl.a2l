ASAP2_VERSION 1 61
/begin PROJECT leaderAppl ""
/begin HEADER "" PROJECT_NO leaderAppl VERSION "14.0" /end HEADER
/begin MODULE leaderAppl ""
/begin IF_DATA XCP
 /begin PROTOCOL_LAYER 0x0100 /* XCP_PROTOCOL_LAYER_VERSION */ 500 /* TIMEOUT1 */ 2500 /* TIMEOUT2 */ 100 /* TIMEOUT3 */ 100 /* TIMEOUT4 */ 100 /* TIMEOUT5 */ 100 /* TIMEOUT6 */ 500 /* TIMEOUT7 */ 255 /* MAX_CTO */ 1408 /* MAX_DTO */ BYTE_ORDER_MSB_LAST ADDRESS_GRANULARITY_BYTE OPTIONAL_CMD SET_MTA OPTIONAL_CMD UPLOAD OPTIONAL_CMD SHORT_UPLOAD OPTIONAL_CMD BUILD_CHECKSUM OPTIONAL_CMD DOWNLOAD OPTIONAL_CMD DOWNLOAD_MAX OPTIONAL_CMD SHORT_DOWNLOAD OPTIONAL_CMD MODIFY_BITS OPTIONAL_CMD SET_CAL_PAGE OPTIONAL_CMD GET_CAL_PAGE OPTIONAL_CMD CLEAR_DAQ_LIST OPTIONAL_CMD SET_DAQ_PTR OPTIONAL_CMD WRITE_DAQ OPTIONAL_CMD SET_DAQ_LIST_MODE OPTIONAL_CMD GET_DAQ_LIST_MODE OPTIONAL_CMD START_STOP_DAQ_LIST OPTIONAL_CMD START_STOP_SYNCH OPTIONAL_CMD GET_DAQ_CLOCK OPTIONAL_CMD FREE_DAQ OPTIONAL_CMD ALLOC_DAQ OPTIONAL_CMD ALLOC_ODT OPTIONAL_CMD ALLOC_ODT_ENTRY /end PROTOCOL_LAYER
 /begin DAQ DYNAMIC /* DAQ_CONFIG_TYPE */ 65535 /* MAX_DAQ */ 2 /* MAX_EVENT_CHANNEL */ 0 /* MIN_DAQ */ OPTIMISATION_TYPE_DEFAULT ADDRESS_EXTENSION_FREE IDENTIFICATION_FIELD_TYPE_ABSOLUTE GRANULARITY_ODT_ENTRY_SIZE_DAQ_BYTE 255 /* MAX_ODT_ENTRY_SIZE_DAQ */ NO_OVERLOAD_INDICATION PRESCALER_SUPPORTED /begin TIMESTAMP_SUPPORTED 1 /* TIMESTAMP_TICKS */ SIZE_DWORD UNIT_1MS /end TIMESTAMP_SUPPORTED
  /begin EVENT "Periodic Task 1" /* NAME */ "t1" /* SHORT_NAME */ 1 /* NUMBER */ DAQ /* DIRECTION */ 255 /* MAX_DAQ_LIST */ 1 /* TIME_CYCLE */ 6 /* TIME_UNIT */ 0 /* PRIORITY */ /end EVENT
 /end DAQ
 /begin PAG 1 /* MAX_SEGMENTS */ /end PAG
 /begin XCP_ON_TCP_IP 0x0100 /* XCP_ON_TCP_IP_VERSION */ 35739 /* PORT */ ADDRESS "127.0.0.1" /end XCP_ON_TCP_IP
/end IF_DATA
/begin MOD_COMMON "" ALIGNMENT_BYTE 1 ALIGNMENT_FLOAT32_IEEE 4 ALIGNMENT_FLOAT64_IEEE 8 ALIGNMENT_INT64 8 ALIGNMENT_LONG 4 ALIGNMENT_WORD 2 BYTE_ORDER MSB_LAST /end MOD_COMMON
/begin MOD_PAR "" ADDR_EPK 0x00007000 EPK "3C2F3C6F41B649B08CC4B70984A4FD5C"
 /begin MEMORY_SEGMENT VEOS_CAL "" DATA /* PrgType */ FLASH /* MemoryType */ EXTERN /* Attribute */ 0x00007000 0x0000004C /* Size */ -1 -1 -1 -1 -1 /* Offset */
  /begin IF_DATA XCP
   /begin SEGMENT 0 /* SEGMENT_NUMBER */ 2 /* NUMBER_OF_PAGES */ 0 /* ADDRESS_EXTENSION */ 0 /* COMPRESSION_METHOD */ 0 /* ENCRYPTION_METHOD */
    /begin PAGE 0 /* PAGE_NUMBER */ ECU_ACCESS_DONT_CARE XCP_READ_ACCESS_DONT_CARE XCP_WRITE_ACCESS_DONT_CARE /end PAGE
    /begin PAGE 1 /* PAGE_NUMBER */ ECU_ACCESS_DONT_CARE XCP_READ_ACCESS_DONT_CARE XCP_WRITE_ACCESS_NOT_ALLOWED /end PAGE
   /end SEGMENT
  /end IF_DATA
 /end MEMORY_SEGMENT
/end MOD_PAR
/begin CHARACTERISTIC BusConnectionState "" VALUE 0x00007040 VEOS_Scalar_UBYTE 0 VpuEnvironmentConnection 0 1 /end CHARACTERISTIC
/begin CHARACTERISTIC VpuConnectionState "" VALUE 0x00007044 VEOS_Scalar_UBYTE 0 VpuEnvironmentConnection 0 1 /end CHARACTERISTIC
/begin CHARACTERISTIC VpuPortsConnectionState "" VALUE 0x00007048 VEOS_Scalar_UBYTE 0 VpuEnvironmentConnection 0 1 /end CHARACTERISTIC
/begin CHARACTERISTIC BatteryVoltageValue "" VALUE 0x00006060 Scalar_FLOAT64_IEEE 0 leaderAppl_CM_double -1.7976931348623157E+308 1.7976931348623157E+308 /end CHARACTERISTIC
/begin CHARACTERISTIC SyncValue "" VALUE 0x0000D1C0 Scalar_FLOAT64_IEEE 0 leaderAppl_CM_double -1.7976931348623157E+308 1.7976931348623157E+308 /end CHARACTERISTIC
/begin CHARACTERISTIC TurnSignalLeverValue "" VALUE 0x0000D1B8 Scalar_FLOAT64_IEEE 0 leaderAppl_CM_double -1.7976931348623157E+308 1.7976931348623157E+308 /end CHARACTERISTIC
/begin CHARACTERISTIC WarningLightSwitchValue "" VALUE 0x0000D1B0 Scalar_FLOAT64_IEEE 0 leaderAppl_CM_double -1.7976931348623157E+308 1.7976931348623157E+308 /end CHARACTERISTIC
/begin COMPU_METHOD VEOS_Integer_Identity "CompuMethod for VEOS Integer data types" IDENTICAL "%.0" "" /end COMPU_METHOD
/begin COMPU_METHOD VEOS_Float64_Identity "CompuMethod for VEOS Float64 data types" IDENTICAL "%.15" "" /end COMPU_METHOD
/begin COMPU_METHOD VpuEnvironmentConnection "" TAB_VERB "%0.0" "" COMPU_TAB_REF VpuEnvironmentConnection_COMPU_VTAB /end COMPU_METHOD
/begin COMPU_METHOD leaderAppl_CM_double "Q = V" RAT_FUNC "%15.10" "" COEFFS 0 1 0 0 0 1 /end COMPU_METHOD
/begin COMPU_METHOD leaderAppl_CM_uint8 "Q = V" RAT_FUNC "%3.0" "" COEFFS 0 1 0 0 0 1 /end COMPU_METHOD
/begin COMPU_VTAB_RANGE VpuEnvironmentConnection_COMPU_VTAB "" 2 /* NumberValueTriples */ 0 0 "CONNECTED" /* InValMin, InValMax and OutVal */ 1 1 "DISCONNECTED" /* InValMin, InValMax and OutVal */ DEFAULT_VALUE "UNKNOWN" /end COMPU_VTAB_RANGE
/begin FUNCTION XIL_API "" /begin SUB_FUNCTION EESPort /end SUB_FUNCTION /end FUNCTION
/begin FUNCTION EESPort ""
 /begin LOC_MEASUREMENT Active_ErrorSet Error_Activated Error_Switching Flags Trigger /end LOC_MEASUREMENT
/end FUNCTION
/begin FUNCTION Simulation_and_RTOS "" /begin SUB_FUNCTION Task_Information_Variables Simulation /end SUB_FUNCTION /end FUNCTION
/begin FUNCTION Task_Information_Variables "" /begin SUB_FUNCTION Virtual_Task_0 /end SUB_FUNCTION /end FUNCTION
/begin FUNCTION Virtual_Task_0 "" /begin LOC_MEASUREMENT Overrun_Count Task_Turnaround_Time Task_Call_Counter /end LOC_MEASUREMENT /end FUNCTION
/begin FUNCTION Simulation "" /begin LOC_MEASUREMENT SimulationTime SimulationCounter_1ns /end LOC_MEASUREMENT /end FUNCTION
/begin FUNCTION Diagnostics "" /begin SUB_FUNCTION Failure_Simulation ApplicationProcess /end SUB_FUNCTION /end FUNCTION
/begin FUNCTION Failure_Simulation "" /begin SUB_FUNCTION Simulator /end SUB_FUNCTION /end FUNCTION
/begin FUNCTION Simulator ""
 /begin REF_CHARACTERISTIC BusConnectionState VpuConnectionState VpuPortsConnectionState /end REF_CHARACTERISTIC
/end FUNCTION
/begin FUNCTION ApplicationProcess "" /begin SUB_FUNCTION Runtime /end SUB_FUNCTION /end FUNCTION
/begin FUNCTION Runtime "" /begin LOC_MEASUREMENT RuntimeVersion RealTimeDeviation /end LOC_MEASUREMENT /end FUNCTION
/begin GROUP leaderAppl "leaderAppl" /begin REF_CHARACTERISTIC SyncValue /end REF_CHARACTERISTIC ROOT /begin SUB_GROUP Root_leader /end SUB_GROUP /end GROUP
/begin GROUP Root_leader "leaderAppl/leader" /begin SUB_GROUP S2_CentralLightEcu /end SUB_GROUP /end GROUP
/begin GROUP S2_CentralLightEcu "leaderAppl/leader/CentralLightEcu"
 /begin REF_CHARACTERISTIC BatteryVoltageValue TurnSignalLeverValue WarningLightSwitchValue /end REF_CHARACTERISTIC
 /begin SUB_GROUP S3_CentralLightEcu /end SUB_GROUP
/end GROUP
/begin GROUP S3_CentralLightEcu "leaderAppl/leader/CentralLightEcu/CentralLightEcu" /begin REF_MEASUREMENT WarningLightIndicator /end REF_MEASUREMENT /end GROUP
/begin MEASUREMENT Active_ErrorSet "" ULONG VEOS_Integer_Identity 1 0 0 4294967295 ECU_ADDRESS 0x00006010 LAYOUT ROW_DIR /end MEASUREMENT
/begin MEASUREMENT Error_Activated "" ULONG VEOS_Integer_Identity 1 0 0 4294967295 ECU_ADDRESS 0x0000600C LAYOUT ROW_DIR /end MEASUREMENT
/begin MEASUREMENT Error_Switching "" ULONG VEOS_Integer_Identity 1 0 0 4294967295 ECU_ADDRESS 0x00006008 LAYOUT ROW_DIR /end MEASUREMENT
/begin MEASUREMENT Flags "" ULONG VEOS_Integer_Identity 1 0 0 4294967295 ECU_ADDRESS 0x0000D030 LAYOUT ROW_DIR /end MEASUREMENT
/begin MEASUREMENT Trigger "" ULONG VEOS_Integer_Identity 1 0 0 4294967295 ECU_ADDRESS 0x0000D02C LAYOUT ROW_DIR /end MEASUREMENT
/begin MEASUREMENT Overrun_Count "" ULONG VEOS_Integer_Identity 1 0 0 4294967295 ECU_ADDRESS 0x000083E8 LAYOUT ROW_DIR /end MEASUREMENT
/begin MEASUREMENT Task_Turnaround_Time "" FLOAT64_IEEE VEOS_Float64_Identity 1 0 -1.7976931348623157E+308 1.7976931348623157E+308 ECU_ADDRESS 0x000083E0 LAYOUT ROW_DIR /end MEASUREMENT
/begin MEASUREMENT Task_Call_Counter "" ULONG VEOS_Integer_Identity 1 0 0 4294967295 ECU_ADDRESS 0x0000D058 LAYOUT ROW_DIR /end MEASUREMENT
/begin MEASUREMENT SimulationTime "" FLOAT64_IEEE VEOS_Float64_Identity 1 0 -1.7976931348623157E+308 1.7976931348623157E+308 ECU_ADDRESS 0x0000D0A8 LAYOUT ROW_DIR /end MEASUREMENT
/begin MEASUREMENT SimulationCounter_1ns "" A_INT64 VEOS_Integer_Identity 1 0 -9.223372036854776E+18 9.223372036854776E+18 ECU_ADDRESS 0x0000D0A0 LAYOUT ROW_DIR /end MEASUREMENT
/begin MEASUREMENT RuntimeVersion "" UWORD VEOS_Integer_Identity 1 0 0 65535 ECU_ADDRESS 0x000086E0 LAYOUT ROW_DIR MATRIX_DIM 4 1 1 /end MEASUREMENT
/begin MEASUREMENT RealTimeDeviation "" FLOAT64_IEEE VEOS_Float64_Identity 1 0 -1.7976931348623157E+308 1.7976931348623157E+308 ECU_ADDRESS 0x0000D098 LAYOUT ROW_DIR /end MEASUREMENT
/begin MEASUREMENT WarningLightIndicator "" UBYTE leaderAppl_CM_uint8 0 0 0 255 ECU_ADDRESS 0x0000D1C8 LAYOUT ROW_DIR /end MEASUREMENT
/begin RECORD_LAYOUT VEOS_Scalar_BOOLEAN FNC_VALUES 1 UBYTE COLUMN_DIR DIRECT /end RECORD_LAYOUT
/begin RECORD_LAYOUT VEOS_Scalar_UBYTE FNC_VALUES 1 UBYTE COLUMN_DIR DIRECT /end RECORD_LAYOUT
/begin RECORD_LAYOUT VEOS_Scalar_BYTE FNC_VALUES 1 SBYTE COLUMN_DIR DIRECT /end RECORD_LAYOUT
/begin RECORD_LAYOUT VEOS_Scalar_UWORD FNC_VALUES 1 UWORD COLUMN_DIR DIRECT /end RECORD_LAYOUT
/begin RECORD_LAYOUT VEOS_Scalar_SWORD FNC_VALUES 1 SWORD COLUMN_DIR DIRECT /end RECORD_LAYOUT
/begin RECORD_LAYOUT VEOS_Scalar_ULONG FNC_VALUES 1 ULONG COLUMN_DIR DIRECT /end RECORD_LAYOUT
/begin RECORD_LAYOUT VEOS_Scalar_LONG FNC_VALUES 1 SLONG COLUMN_DIR DIRECT /end RECORD_LAYOUT
/begin RECORD_LAYOUT VEOS_Scalar_FLOAT32_IEEE FNC_VALUES 1 FLOAT32_IEEE COLUMN_DIR DIRECT /end RECORD_LAYOUT
/begin RECORD_LAYOUT VEOS_Scalar_FLOAT64_IEEE FNC_VALUES 1 FLOAT64_IEEE COLUMN_DIR DIRECT /end RECORD_LAYOUT
/begin RECORD_LAYOUT Scalar_BOOLEAN FNC_VALUES 1 UBYTE ROW_DIR DIRECT /end RECORD_LAYOUT
/begin RECORD_LAYOUT Scalar_UBYTE FNC_VALUES 1 UBYTE ROW_DIR DIRECT /end RECORD_LAYOUT
/begin RECORD_LAYOUT Scalar_BYTE FNC_VALUES 1 SBYTE ROW_DIR DIRECT /end RECORD_LAYOUT
/begin RECORD_LAYOUT Scalar_UWORD FNC_VALUES 1 UWORD ROW_DIR DIRECT /end RECORD_LAYOUT
/begin RECORD_LAYOUT Scalar_SWORD FNC_VALUES 1 SWORD ROW_DIR DIRECT /end RECORD_LAYOUT
/begin RECORD_LAYOUT Scalar_ULONG FNC_VALUES 1 ULONG ROW_DIR DIRECT /end RECORD_LAYOUT
/begin RECORD_LAYOUT Scalar_LONG FNC_VALUES 1 SLONG ROW_DIR DIRECT /end RECORD_LAYOUT
/begin RECORD_LAYOUT Scalar_FLOAT32_IEEE FNC_VALUES 1 FLOAT32_IEEE ROW_DIR DIRECT /end RECORD_LAYOUT
/begin RECORD_LAYOUT Scalar_FLOAT64_IEEE FNC_VALUES 1 FLOAT64_IEEE ROW_DIR DIRECT /end RECORD_LAYOUT
/begin RECORD_LAYOUT Lookup1D_BOOLEAN FNC_VALUES 1 UBYTE ROW_DIR DIRECT /end RECORD_LAYOUT
/begin RECORD_LAYOUT Lookup1D_BYTE FNC_VALUES 1 SBYTE ROW_DIR DIRECT /end RECORD_LAYOUT
/begin RECORD_LAYOUT Lookup1D_UBYTE FNC_VALUES 1 UBYTE ROW_DIR DIRECT /end RECORD_LAYOUT
/begin RECORD_LAYOUT Lookup1D_UWORD FNC_VALUES 1 UWORD ROW_DIR DIRECT /end RECORD_LAYOUT
/begin RECORD_LAYOUT Lookup1D_WORD FNC_VALUES 1 SWORD ROW_DIR DIRECT /end RECORD_LAYOUT
/begin RECORD_LAYOUT Lookup1D_ULONG FNC_VALUES 1 ULONG ROW_DIR DIRECT /end RECORD_LAYOUT
/begin RECORD_LAYOUT Lookup1D_LONG FNC_VALUES 1 SLONG ROW_DIR DIRECT /end RECORD_LAYOUT
/begin RECORD_LAYOUT Lookup1D_FLOAT32_IEEE FNC_VALUES 1 FLOAT32_IEEE ROW_DIR DIRECT /end RECORD_LAYOUT
/begin RECORD_LAYOUT Lookup1D_FLOAT64_IEEE FNC_VALUES 1 FLOAT64_IEEE ROW_DIR DIRECT /end RECORD_LAYOUT
/begin RECORD_LAYOUT Lookup1D_X_BOOLEAN AXIS_PTS_X 1 UBYTE INDEX_INCR DIRECT /end RECORD_LAYOUT
/begin RECORD_LAYOUT Lookup1D_X_BYTE AXIS_PTS_X 1 SBYTE INDEX_INCR DIRECT /end RECORD_LAYOUT
/begin RECORD_LAYOUT Lookup1D_X_UBYTE AXIS_PTS_X 1 UBYTE INDEX_INCR DIRECT /end RECORD_LAYOUT
/begin RECORD_LAYOUT Lookup1D_X_UWORD AXIS_PTS_X 1 UWORD INDEX_INCR DIRECT /end RECORD_LAYOUT
/begin RECORD_LAYOUT Lookup1D_X_WORD AXIS_PTS_X 1 SWORD INDEX_INCR DIRECT /end RECORD_LAYOUT
/begin RECORD_LAYOUT Lookup1D_X_ULONG AXIS_PTS_X 1 ULONG INDEX_INCR DIRECT /end RECORD_LAYOUT
/begin RECORD_LAYOUT Lookup1D_X_LONG AXIS_PTS_X 1 SLONG INDEX_INCR DIRECT /end RECORD_LAYOUT
/begin RECORD_LAYOUT Lookup1D_X_FLOAT32_IEEE AXIS_PTS_X 1 FLOAT32_IEEE INDEX_INCR DIRECT /end RECORD_LAYOUT
/begin RECORD_LAYOUT Lookup1D_X_FLOAT64_IEEE AXIS_PTS_X 1 FLOAT64_IEEE INDEX_INCR DIRECT /end RECORD_LAYOUT
/begin RECORD_LAYOUT Lookup2D_BOOLEAN FNC_VALUES 1 UBYTE ROW_DIR DIRECT /end RECORD_LAYOUT
/begin RECORD_LAYOUT Lookup2D_UBYTE FNC_VALUES 1 UBYTE ROW_DIR DIRECT /end RECORD_LAYOUT
/begin RECORD_LAYOUT Lookup2D_BYTE FNC_VALUES 1 SBYTE ROW_DIR DIRECT /end RECORD_LAYOUT
/begin RECORD_LAYOUT Lookup2D_UWORD FNC_VALUES 1 UWORD ROW_DIR DIRECT /end RECORD_LAYOUT
/begin RECORD_LAYOUT Lookup2D_WORD FNC_VALUES 1 SWORD ROW_DIR DIRECT /end RECORD_LAYOUT
/begin RECORD_LAYOUT Lookup2D_ULONG FNC_VALUES 1 ULONG ROW_DIR DIRECT /end RECORD_LAYOUT
/begin RECORD_LAYOUT Lookup2D_LONG FNC_VALUES 1 SLONG ROW_DIR DIRECT /end RECORD_LAYOUT
/begin RECORD_LAYOUT Lookup2D_FLOAT32_IEEE FNC_VALUES 1 FLOAT32_IEEE ROW_DIR DIRECT /end RECORD_LAYOUT
/begin RECORD_LAYOUT Lookup2D_FLOAT64_IEEE FNC_VALUES 1 FLOAT64_IEEE ROW_DIR DIRECT /end RECORD_LAYOUT
/begin RECORD_LAYOUT Lookup2D_X_BOOLEAN AXIS_PTS_X 1 UBYTE INDEX_INCR DIRECT /end RECORD_LAYOUT
/begin RECORD_LAYOUT Lookup2D_X_UBYTE AXIS_PTS_X 1 UBYTE INDEX_INCR DIRECT /end RECORD_LAYOUT
/begin RECORD_LAYOUT Lookup2D_X_BYTE AXIS_PTS_X 1 SBYTE INDEX_INCR DIRECT /end RECORD_LAYOUT
/begin RECORD_LAYOUT Lookup2D_X_UWORD AXIS_PTS_X 1 UWORD INDEX_INCR DIRECT /end RECORD_LAYOUT
/begin RECORD_LAYOUT Lookup2D_X_WORD AXIS_PTS_X 1 SWORD INDEX_INCR DIRECT /end RECORD_LAYOUT
/begin RECORD_LAYOUT Lookup2D_X_ULONG AXIS_PTS_X 1 ULONG INDEX_INCR DIRECT /end RECORD_LAYOUT
/begin RECORD_LAYOUT Lookup2D_X_LONG AXIS_PTS_X 1 SLONG INDEX_INCR DIRECT /end RECORD_LAYOUT
/begin RECORD_LAYOUT Lookup2D_X_FLOAT32_IEEE AXIS_PTS_X 1 FLOAT32_IEEE INDEX_INCR DIRECT /end RECORD_LAYOUT
/begin RECORD_LAYOUT Lookup2D_X_FLOAT64_IEEE AXIS_PTS_X 1 FLOAT64_IEEE INDEX_INCR DIRECT /end RECORD_LAYOUT
/end MODULE
/end PROJECT
